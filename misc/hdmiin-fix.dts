/dts-v1/;
/plugin/;

/ {
    fragment@0 {
        target = <&hdmirx_ctrler>;
        __overlay__ {
            #sound-dai-cells = <1>;
        };
    };

    fragment@1 {
        target-path = "/";
        __overlay__ {
            hdmiin-sound {
                compatible = "rockchip,hdmi";
                rockchip,mclk-fs = <128>;
                rockchip,format = "i2s";
                rockchip,bitclock-master = <&hdmirx_ctrler>;
                rockchip,frame-master = <&hdmirx_ctrler>;
                rockchip,card-name = "rockchip-hdmiin";
                rockchip,cpu = <&i2s7_8ch>;
                rockchip,codec = <&hdmirx_ctrler 0>;
                rockchip,jack-det;
                status = "okay";
            };
        };
    };
};
